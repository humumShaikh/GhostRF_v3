// NRF24 Connection
// SCK=18, MISO=19, MOSI=23, CS=5, CE=4/15

#include <Arduino.h>
#include <RF24.h>
#include <Preferences.h>
#include <Adafruit_SH110X.h>

#define dial 36
#define select 25
#define red 39
#define b1 35
#define b2 34

Adafruit_SH1106G oled = Adafruit_SH1106G (128,64,&Wire,-1);

const unsigned char CWIR3_Ghost_RF [] PROGMEM = {
	0x00, 0x00, 0x00, 0x00, 0x00, 0x00, 0x00, 0x00, 0x00, 0x00, 0x00, 0x00, 0x00, 0x00, 0x00, 0x00, 
	0x00, 0x00, 0x00, 0x00, 0x00, 0x00, 0x00, 0x00, 0x00, 0x00, 0x00, 0x00, 0x00, 0x00, 0x00, 0x00, 
	0x00, 0x00, 0x00, 0x00, 0x00, 0x00, 0x00, 0x00, 0x00, 0x00, 0x00, 0x00, 0x00, 0x00, 0x00, 0x00, 
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	0x00, 0x00, 0x00, 0x00, 0x00, 0x00, 0x00, 0x00, 0x00, 0x00, 0x00, 0x00, 0x00, 0x00, 0x00, 0x00
};
const unsigned char NRF_Operating [] PROGMEM = {
	0x00, 0x00, 0x00, 0x00, 0x00, 0x00, 0x00, 0x00, 0x00, 0x00, 0x00, 0x00, 0x00, 0x00, 0x00, 0x00, 
	0x00, 0x00, 0x00, 0x00, 0x00, 0x00, 0x00, 0x00, 0x00, 0x00, 0x00, 0x00, 0x00, 0x00, 0x00, 0x00, 
	0x00, 0x00, 0x00, 0x00, 0x00, 0x00, 0x00, 0x00, 0x00, 0x00, 0x00, 0x00, 0x00, 0x00, 0x00, 0x00, 
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	0x00, 0x00, 0x00, 0x00, 0x00, 0x00, 0x00, 0x00, 0x00, 0x00, 0x00, 0x00, 0x00, 0x00, 0x00, 0x00
};
const unsigned char NRF_Operating_2 [] PROGMEM = {
	0x00, 0x00, 0x00, 0x00, 0x00, 0x00, 0x00, 0x00, 0x00, 0x00, 0x00, 0x00, 0x00, 0x00, 0x00, 0x00, 
	0x00, 0x00, 0x00, 0x00, 0x00, 0x00, 0x00, 0x00, 0x00, 0x00, 0x00, 0x00, 0x00, 0x00, 0x00, 0x00, 
	0x00, 0x00, 0x00, 0x00, 0x00, 0x00, 0x00, 0x00, 0x00, 0x00, 0x00, 0x00, 0x00, 0x00, 0x00, 0x00, 
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	0x00, 0x00, 0x00, 0x00, 0x00, 0x00, 0x00, 0x00, 0x00, 0x00, 0x00, 0x00, 0x00, 0x00, 0x00, 0x00
};


SPIClass *hp = nullptr;

RF24 radio(4, 5);///CE,CSN
Preferences preferences;

byte i = 45;

unsigned int flag = 0;

const int interval = 10000;
unsigned long previousMillis = 0;
unsigned long currentMillis = 0;

void initHP() {
  hp = new SPIClass(VSPI);
  hp->begin();
  if (radio.begin(hp)) {
    delay(200);  
    radio.setAutoAck(false);
    radio.stopListening();
    radio.setRetries(0, 0);
    radio.setPayloadSize(5);   ////SET VALUE ON RF24.CPP
    radio.setAddressWidth(3);  ////SET VALUE ON RF24.CPP
    radio.setPALevel(RF24_PA_MAX, true);
    radio.setDataRate(RF24_2MBPS);
    radio.setCRCLength(RF24_CRC_DISABLED);
    radio.startConstCarrier(RF24_PA_MAX, i);
  } 
}

void setup(void) {
  Serial.begin(115200);
  oled.begin(0x3c);
  oled.clearDisplay();
  preferences.begin("Startup_Log", false);
  unsigned int counter = preferences.getUInt("counter", 0);

  if((counter%2)==0){
    oled.drawBitmap(0,0,NRF_Operating,128,64,SH110X_WHITE);
    oled.display();
    pinMode(13,OUTPUT);
    pinMode(14,OUTPUT);
    pinMode(26,OUTPUT);
    pinMode(27,OUTPUT);
    digitalWrite(13,HIGH);
    digitalWrite(14,LOW);
    digitalWrite(26,HIGH);
    digitalWrite(27,LOW);
    counter++;
    preferences.putUInt("counter", counter);
  }

  else if((counter%2)!=0){
    oled.drawBitmap(0,0,NRF_Operating_2,128,64,SH110X_WHITE);
    oled.display();
    pinMode(13,OUTPUT);
    pinMode(14,OUTPUT);
    pinMode(26,OUTPUT);
    pinMode(27,OUTPUT);
    digitalWrite(13,LOW);
    digitalWrite(14,HIGH);
    digitalWrite(26,LOW);
    digitalWrite(27,HIGH);
    counter++;
    preferences.putUInt("counter", counter);
  }
  preferences.end();
  initHP();
}


void loop() {
  for (int i = 0; i < 79; i++) {
    radio.setChannel(i);
    currentMillis = millis();
    if((currentMillis - previousMillis)>=interval){
      ESP.restart();
    }
  }
}





/*
void setup(){
  pinMode(dial,INPUT);
  pinMode(select,INPUT);
  pinMode(red,INPUT);
  pinMode(b1,INPUT);
  pinMode(b2,INPUT);
  oled.begin(0x3c,true);
  oled.clearDisplay();
  oled.drawBitmap(0,0,CWIR3_Ghost_RF,128,64,SH110X_WHITE);
  oled.display();
  delay(1000);
  oled.clearDisplay();
  oled.setTextColor(SH110X_WHITE);
  oled.setTextSize(1);
}

void loop(){
  oled.setCursor(0,3);
  oled.print("Dial : ");
  oled.println(analogRead(dial));
  oled.print("Select : ");
  oled.println(analogRead(select));
  oled.print("Red : ");
  oled.println(digitalRead(red));
  oled.print("B1 : ");
  oled.println(digitalRead(b1));
  oled.print("B2 : ");
  oled.println(digitalRead(b2));
  oled.display();
  delay(50);
  oled.clearDisplay();
}
*/
